/*
 * Copyright (c) 2025 Alexander Kozhinov <ak.alexander.kozhinov@gmail.com>
 * SPDX-License-Identifier: Apache-2.0
 */

/*
 * IMPORTANT: D33 (PB0) shall be connected to D27 (PB2) by a jumper wire
 */

/ {
	zephyr,user {
		opamp = <&opamp2>;
	};
};

&opamp2 {
	// /* vinm */
	// pinctrl-0 = <&opamp2_vinm_pa5>; /* vinm0 */
	// pinctrl-1 = <&opamp2_vinm_pc5>; /* vinm1 */
	// /* vinp */
	// pinctrl-2 = <&opamp2_vinp_pa7>; /* vinp0 */
	// pinctrl-3 = <&opamp2_vinp_pb14>; /* vinp1 */
	// pinctrl-4 = <&opamp2_vinp_pb0>; /* vinp2 */
	// pinctrl-5 = <&opamp2_vinp_pb14>; /* vinp3 */
	// /* vout */
	// pinctrl-6 = <&opamp2_vout_pa6>;
	// pinctrl-names = "vinm0", "vinm1",
	// 		"vinp0", "vinp1", "vinp2", "vinp3",
	// 		"vout";

	pinctrl-0 = <&opamp2_vinm_pa5 &opamp2_vinm_pc5
		     &opamp2_vinp_pb14 &opamp2_vinp_pa7
		     &opamp2_vout_pa6>;
	pinctrl-names = "default";
	functional-mode = "non_inverting";
	vinm = "VINM0", "VINM1";
	vinp = "VINP0", "VINP1";
	// vout;
	st,self-calibration;
	status = "okay";
};
