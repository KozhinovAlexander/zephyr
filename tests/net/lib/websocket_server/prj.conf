## CMakeLists.txt
```
#
# Copyright (c) 2022 Alexander Kozhinov <ak.alexander.kozhinov@gmail.com>
# SPDX-License-Identifier: Apache-2.0
#

cmake_minimum_required(VERSION 3.20.0)
find_package(Zephyr REQUIRED HINTS $ENV{ZEPHYR_BASE})
project(websocket_server)

FILE(GLOB app_headers
# 	"$ENV{ZEPHYR_BASE}/subsys/net/lib/websocket_server/include"
)

FILE(GLOB app_sources
	"src/*.c"
	# "$ENV{ZEPHYR_BASE}/subsys/net/lib/websocket_server/*.c"
)

target_include_directories(app PRIVATE ${app_headers})
target_sources(app PRIVATE ${app_sources})
```

## prj.conf
```kconfig
CONFIG_ZTEST=y
CONFIG_ZTEST_NEW_API=y

# CONFIG_NEWLIB_LIBC=y
# CONFIG_NETWORKING=y
CONFIG_MAIN_STACK_SIZE=4096

# Websocket server
CONFIG_WEBSOCKET_SERVER=y
# CONFIG_NET_SOCKETS_SOCKOPT_TLS=n
# CONFIG_WEBSOCKET_SRV_PORT=8080
# CONFIG_WEBSOCKET_SRV_LOG_LEVEL_DBG=y
```

## src/main.c
```c
/** @file
 @brief Websocket Server API tests

 A test framework for WebSocket Server API
 */
/*
 * Copyright (c) 2022 Alexander Kozhinov <ak.alexander.kozhinov@gmail.com>
 * SPDX-License-Identifier: Apache-2.0
 */

#include <zephyr/logging/log.h>
LOG_MODULE_REGISTER(net_websocket_server, LOG_LEVEL_DBG);

#include <zephyr/ztest.h>

ZTEST_SUITE(websocket_server_test_framework, NULL, NULL, NULL, NULL, NULL);

void test_main(void)
{
	ztest_run_test_suite(websocket_server_test_framework);
}
```

## src/test_websocket_frame.c
```c
/** @file
 @brief Websocket Server API HTTP Parser tests

 A test framework for WebSocket Server API HTTP parser
 */
/*
 * Copyright (c) 2022 Alexander Kozhinov <ak.alexander.kozhinov@gmail.com>
 * SPDX-License-Identifier: Apache-2.0
 */

#include <fcntl.h>

#include <zephyr/sys/util.h>
#include <zephyr/subsys/net/lib/websocket_server/include/websocket_frame.h>

#include <zephyr/ztest_assert.h>


ZTEST(websocket_server_test_framework, test_websocket_frame)
{
	int ret = +2;
	
	// http_parser_t hp;
	// ret = websocket_server_http_parser_init(&hp);
	zassert_true(ret >= 0, "----- websocket_frame: return code must be zero or positive");
}
```

## src/test_ws_http_parser.c
```c
/** @file
 @brief Websocket Server API HTTP Parser tests

 A test framework for WebSocket Server API HTTP parser
 */
/*
 * Copyright (c) 2022 Alexander Kozhinov <ak.alexander.kozhinov@gmail.com>
 * SPDX-License-Identifier: Apache-2.0
 */

#include <fcntl.h>

#include <zephyr/logging/log.h>
LOG_MODULE_DECLARE(net_websocket_server_http_parser, LOG_LEVEL_DBG);

#include <zephyr/sys/util.h>
#include <zephyr/net/websocket_server.h>

#include <zephyr/ztest_assert.h>

// #include "websocket_server_http_parser.h"


ZTEST(websocket_server_test_framework, test_ws_http_opening_handshake_parse)
{
	int ret = 3;
	
	// http_parser_t hp;
	// ret = websocket_server_http_parser_init(&hp);
	zassert_true(ret >= 0, "return code must be zero or positive");
}
```
