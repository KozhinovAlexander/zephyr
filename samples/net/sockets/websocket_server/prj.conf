## CMakeLists.txt
```
#
# Copyright (c) 2022 Alexander Kozhinov <ak.alexander.kozhinov@gmail.com>
# SPDX-License-Identifier: Apache-2.0
#

cmake_minimum_required(VERSION 3.20.0)

find_package(Zephyr REQUIRED HINTS $ENV{ZEPHYR_BASE})
project(websocket_server_sample)

if(CONFIG_MBEDTLS_KEY_EXCHANGE_PSK_ENABLED AND
  (CONFIG_NET_SAMPLE_PSK_HEADER_FILE STREQUAL "dummy_psk.h"))
	add_custom_target(development_psk
		COMMAND ${CMAKE_COMMAND} -E echo "----------------------------------------------------------"
		COMMAND ${CMAKE_COMMAND} -E echo "--- WARNING: Using dummy PSK! Only suitable for        ---"
		COMMAND ${CMAKE_COMMAND} -E echo "--- development. Set NET_SAMPLE_PSK_HEADER_FILE to use ---"
		COMMAND ${CMAKE_COMMAND} -E echo "--- own pre-shared key.                                ---"
		COMMAND ${CMAKE_COMMAND} -E echo "----------------------------------------------------------"
	)
	add_dependencies(app development_psk)
endif()

target_sources(app PRIVATE src/main.c)

include(${ZEPHYR_BASE}/samples/net/common/common.cmake)

set(gen_dir ${ZEPHYR_BINARY_DIR}/include/generated/)

set(certs_path ${CMAKE_CURRENT_SOURCE_DIR}/certificates/)
file(GLOB_RECURSE certs_list ${certs_path}/*.der)
foreach(inc_file ${certs_list})
	get_filename_component(inc_file_name ${inc_file} NAME)
	generate_inc_file_for_target(
		app
		${inc_file}
		${gen_dir}/${inc_file_name}.inc
	)
endforeach()
```

## Kconfig
```
# Private config options for websocket-server sample app

# Copyright (c) 2022 Alexander Kozhinov <ak.alexander.kozhinov@gmail.com>
# SPDX-License-Identifier: Apache-2.0

mainmenu "Networking websocket-server sample application"

source "Kconfig.zephyr"
```

## sample.yaml
```
common:
  harness: net
  tags: net socket websocket
  depends_on: netif
  min_flash: 16
sample:
  description: WebSocket Server sample application
  name: WebSocket Server
tests:
  sample.net.sockets.websocket_server.nucleo_h745zi_q:
    extra_args: OVERLAY_CONFIG="overlay-nucleo_h745zi_q.conf"
    tags: net
    platform_allow: nucleo_h745zi_q
```

## prj.conf
```kconfig
# Generic networking options
CONFIG_NETWORKING=y
CONFIG_NET_UDP=n
CONFIG_NET_TCP=y
CONFIG_NET_IPV6=y
CONFIG_NET_IPV4=y
CONFIG_NET_SOCKETS=y
# CONFIG_NET_CONNECTION_MANAGER=y
CONFIG_NET_VLAN=n
CONFIG_NET_L2_IPIP=n

# Number of socket descriptors might need adjusting
# if there are more than 1 handlers defined.  --> ToDo: use it in KConfig of websocket server itself!
CONFIG_POSIX_MAX_FDS=12

# Kernel options
CONFIG_MAIN_STACK_SIZE=2048
CONFIG_ENTROPY_GENERATOR=y
CONFIG_INIT_STACKS=y
# CONFIG_DEBUG=y

# Logging
CONFIG_LOG=y
CONFIG_LOG_BUFFER_SIZE=16384
CONFIG_NET_LOG=y
# CONFIG_NET_STATISTICS=y
# CONFIG_PRINTK=y

# Network buffers
CONFIG_NET_PKT_RX_COUNT=16
CONFIG_NET_PKT_TX_COUNT=16
CONFIG_NET_BUF_RX_COUNT=64
CONFIG_NET_BUF_TX_COUNT=64
CONFIG_NET_CONTEXT_NET_PKT_POOL=y

# IP address options
# CONFIG_NET_IF_UNICAST_IPV6_ADDR_COUNT=3
# CONFIG_NET_IF_MCAST_IPV6_ADDR_COUNT=4
CONFIG_NET_MAX_CONTEXTS=10

# Network shell
# CONFIG_NET_SHELL=y
# CONFIG_SHELL=y

# Websocket server
CONFIG_WEBSOCKET_SERVER=y
CONFIG_NET_SOCKETS_SOCKOPT_TLS=n
# CONFIG_WEBSOCKET_SRV_PORT=8080
CONFIG_WEBSOCKET_SRV_LOG_LEVEL_DBG=y
# CONFIG_WEBSOCKET_SRV_LOG_LEVEL_ERR=y

# Network application options and configuration
CONFIG_NET_CONFIG_SETTINGS=y
CONFIG_NET_CONFIG_NEED_IPV6=y
CONFIG_NET_CONFIG_MY_IPV6_ADDR="2001:db8::1"
CONFIG_NET_CONFIG_PEER_IPV6_ADDR="2001:db8::2"
CONFIG_NET_CONFIG_NEED_IPV4=y
CONFIG_NET_CONFIG_MY_IPV4_ADDR="192.168.178.201"
CONFIG_NET_CONFIG_PEER_IPV4_ADDR="192.168.178.1"
```

## src/main.c
```c
/*
 * Copyright (c) 2022 Alexander Kozhinov <ak.alexander.kozhinov@gmail.com>
 * SPDX-License-Identifier: Apache-2.0
 */

#include <zephyr/logging/log.h>
LOG_MODULE_REGISTER(websocket_server_sample, LOG_LEVEL_DBG);

#include <zephyr/kernel.h>
#include <errno.h>

#include <zephyr/net/websocket_server.h>

#include "certificate.h"

static struct k_sem quit_lock;

static websocket_server_hnd_t hnd;

void main(void)
{
	int ret;
	
	k_sem_init(&quit_lock, 0, K_SEM_MAX_LIMIT);

	ret = websocket_server_init(&hnd);

	k_sem_take(&quit_lock, K_FOREVER);

	LOG_DBG("*** EXIT STATUS: %d***", ret);
}
```

## src/certificate.h
```c
/*
 * Copyright (c) 2018 Nordic Semiconductor ASA
 *
 * SPDX-License-Identifier: Apache-2.0
 */

#ifndef __CERTIFICATE_H__
#define __CERTIFICATE_H__

#define SERVER_CERTIFICATE_TAG 1
#define PSK_TAG 2

#if !defined(CONFIG_NET_SAMPLE_CERTS_WITH_SC)
static const unsigned char server_certificate[] = {
#include "echo-apps-cert.der.inc"
};

/* This is the private key in pkcs#8 format. */
static const unsigned char private_key[] = {
#include "echo-apps-key.der.inc"
};

#else

static const unsigned char ca_certificate[] = {
#include "ca.der.inc"
};

static const unsigned char server_certificate[] = {
#include "server.der.inc"
};

/* This is the private key in pkcs#8 format. */
static const unsigned char private_key[] = {
#include "server_privkey.der.inc"
};
#endif

#endif /* __CERTIFICATE_H__ */
```
