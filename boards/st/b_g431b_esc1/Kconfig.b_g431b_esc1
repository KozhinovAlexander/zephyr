## boards/st/b_g431b_esc1/Kconfig.b_g431b_esc1
```kconfig
# Copyright (c) 2024 Alexander Kozhinov <ak.alexander.kozhinov@gmail.com>
# SPDX-License-Identifier: Apache-2.0

config BOARD_B_G431B_ESC1
	select SOC_STM32G431XX
```

## boards/st/b_g431b_esc1/b_g431b_esc1_defconfig
```kconfig
# Copyright (c) 2024 Alexander Kozhinov <ak.alexander.kozhinov@gmail.com>
# SPDX-License-Identifier: Apache-2.0

# Serial Drivers
CONFIG_SERIAL=y
CONFIG_UART_INTERRUPT_DRIVEN=y

# enable console
CONFIG_CONSOLE=y
CONFIG_UART_CONSOLE=y

# GPIO Controller
CONFIG_GPIO=y

# Enable MPU
CONFIG_ARM_MPU=y

# Enable HW stack protection
CONFIG_HW_STACK_PROTECTION=y

CONFIG_ADC=y
CONFIG_ADC_STM32=y
CONFIG_ADC_STM32_DMA=y
```

## boards/st/b_g431b_esc1/board.yml
```yaml
board:
  name: b_g431b_esc1
  full_name: B-G431B-ESC1 Discovery
  vendor: st
  socs:
    - name: stm32g431xx
```

## drivers/cordic/Kconfig.stm32
```kconfig
# STM32 CORDIC configuration options
#
# Copyright (c) 2024 Alexander Kozhinov <ak.alexander.kozhinov@gmail.com>
# SPDX-License-Identifier: Apache-2.0

config CORDIC_STM32
	bool "STM32 CORDIC driver"
	default y
	depends on DT_HAS_ST_STM32_CORDIC_ENABLED
	# select USE_STM32_LL_CORDIC
	help
	  Enable STM32 CORDIC driver. The CORDIC coprocessor is available
	  on STM32G4, STM32H5, STM32H7, STM32U5 series.
```

## drivers/opamp/Kconfig
```kconfig
# Copyright (c) 2025 Alexander Kozhinov <ak.alexander.kozhinov@gmail.com>
# SPDX-License-Identifier: Apache-2.0

menuconfig OPAMP
	bool "OpAmp drivers"
	help
	  Enable opamp driver configuration.

if OPAMP

module = OPAMP
module-str = opamp
source "subsys/logging/Kconfig.template.log_config"

config OPAMP_INIT_PRIORITY
	int "OpAmp init priority"
	default KERNEL_INIT_PRIORITY_DEVICE
	help
	  OpAmp device driver initialization priority.

rsource "Kconfig.fake_opamp"
rsource "Kconfig.shell"
rsource "Kconfig.stm32_opamp"

endif # OPAMP
```

## drivers/opamp/Kconfig.fake_opamp
```kconfig
# Copyright (c) 2025 Alexander Kozhinov <ak.alexander.kozhinov@gmail.com>
# SPDX-License-Identifier: Apache-2.0

config OPAMP_FAKE_OPAMP
	bool "Fake OpAmp driver"
	default y
	depends on DT_HAS_ZEPHYR_FAKE_OPAMP_ENABLED
	depends on ZTEST
```

## drivers/opamp/Kconfig.shell
```kconfig
# Copyright (c) 2025 Alexander Kozhinov <ak.alexander.kozhinov@gmail.com>
# SPDX-License-Identifier: Apache-2.0

config OPAMP_SHELL
	bool "OpAmp shell"
	default y
	depends on SHELL
	help
	  OpAmp device driver shell.
```

## drivers/opamp/Kconfig.stm32_opamp
```kconfig
# Copyright (c) 2025 Alexander Kozhinov <ak.alexander.kozhinov@gmail.com>
# SPDX-License-Identifier: Apache-2.0

config OPAMP_STM32_OPAMP
	bool "ST STM32 OpAmp driver"
	default y
	depends on DT_HAS_ST_STM32_OPAMP_ENABLED
	select PINCTRL
	select USE_STM32_LL_OPAMP
```

## dts/bindings/comparator/st,stm32-comp.yaml
```yaml
# Copyright (c) 2025 Alexander Kozhinov <ak.alexander.kozhinov@gmail.com>
# SPDX-License-Identifier: Apache-2.0

description: |
  STM32 Comparator

  The following example displays the minimum node layout:

    comp1: comparator@deadbeef {
        compatible = "st,stm32-comp";
        reg = <0xdeadbeef 0x4>;
        interrupts = <0 0>;
        status = "disabled";
    };

  Enabling the comparator node requires setting the minimum default
  configuration of the comparator. This includes selecting the
  positive and negative inputs, and routing them using pinctrl:

    &pinctrl {
        comp1_default: comp1_default {
            ...
        };
    };

    &comp1 {
        status = "okay";
        pinctrl-0 = <&comp1_default>;
        pinctrl-names = "default";

        positive-input = "IN0";
        negative-input = "IN1";
    };

compatible: "st,stm32-comp"

include:
  - base.yaml
  - pinctrl-device.yaml

properties:
  interrupts:
    required: true

  reg:
    required: true

  hysteresis:
    type: string
    enum:
      - NONE
      - 10mV
      - 20mV
      - 30mV
      - 40mV
      - 50mV
      - 60mV
      - 70mV
    default: NONE

  invert-output:
    type: string
    enum:
      - NON_INVERTED
      - INVERTED
    default: NON_INVERTED

  st,exti-line:
    type: int
    description: |
      Number of the Extended Interrupts and Event Controller (EXTI) interrupt
      line connected to the COMPx event.
      Not required, since COMPx interrupt could be routed directly to Nested
      Vectored Interrupt Controller (NVIC).

  st,lock-enable:
    type: boolean

  st,blank-sel:
    type: string
    enum:
      - NONE
      - TIM1_OC5_COMP1
      - TIM1_OC5_COMP2
      - TIM1_OC5_COMP3
      - TIM1_OC5_COMP4
      - TIM1_OC5_COMP5
      - TIM1_OC5_COMP6
      - TIM1_OC5_COMP7
      - TIM2_OC3_COMP1
      - TIM2_OC3_COMP2
      - TIM2_OC3_COMP5
      - TIM2_OC4_COMP3
      - TIM2_OC4_COMP6
      - TIM3_OC3_COMP1
      - TIM3_OC3_COMP2
      - TIM3_OC3_COMP3
      - TIM3_OC3_COMP5
      - TIM3_OC3_COMP7
      - TIM3_OC4_COMP4
      - TIM8_OC5_COMP1
      - TIM8_OC5_COMP2
      - TIM8_OC5_COMP3
      - TIM8_OC5_COMP4
      - TIM8_OC5_COMP5
      - TIM8_OC5_COMP6
      - TIM8_OC5_COMP7
      - TIM15_OC1_COMP4
      - TIM15_OC2_COMP6
      - TIM15_OC2_COMP7
      - TIM20_OC5
      - TIM15_OC1
      - TIM4_OC3
    default: NONE

  positive-input:
    required: true
    type: string
    description: |
      Selects positive input pin given by pinmux controller. This input can be
      typically assigned to one of the predefinded package pins.
      IN0 will correspond to first pinmux pin option and IN1 to the second one.
    enum:
      - IN0
      - IN1
    default: IN0

  negative-input:
    required: true
    type: string
    description: |
      Selects negative input pin given by pinmux controller.
      This input can be typically assigned to one of the predefinded package pins
      or to one of internal signals like VREF_INT or DAC.
      In case of package pin assignment IN0 will correspond to first pinmux pin
      option and IN1 to the second one.
    enum:
      - VREF_INT_1_4
      - VREF_INT_1_2
      - VREF_INT_3_4
      - VREF_INT
      - DAC1_CH1
      - DAC1_CH2
      - DAC2_CH1
      - DAC3_CH1
      - DAC3_CH2
      - DAC4_CH1
      - DAC4_CH2
      - IN0
      - IN1
    default: VREF_INT

  st,miller-effect-hold-enable:
    type: boolean
    description: |
      Miller effect is a hidden feature of stm32, which may be enabled by setting
      bit 1 of COMP_CxCSR register.
      for more info see:
        https://community.st.com/t5/stm32-mcus-products/stm32g431-comparator-bug/m-p/679540#M250779
```

## dts/bindings/opamp/st,stm32-opamp.yaml
```yaml
# Copyright (c) 2025 Alexander Kozhinov <ak.alexander.kozhinov@gmail.com>
# SPDX-License-Identifier: Apache-2.0

description: |
  ST Micro STM32 OPAMP (Operational Amplifier) device tree bindings.

  This opamp has varying configurations which require varying
  properties be set in the devicetree.

  The following example displays the minimum node layout:

    opamp: opamp@deadbeef {
            compatible = st,stm32-opamp;
            reg = <0xdeadbeef 0x1000>;
            status = disabled;
    };

  Enabling the opamp node requires setting the default
  configuration of the opamp.

  The following example displays enabling the opamp in
  single-ended mode, selecting an internal reference:

    &opamp {
            status = okay;
            main-mode = SE;
            psel = AIN0;
            refsel = INT_1V2;
            slew-rate = NORMAL;
    };

  To select an external reference, select the AREF
  reference and add the external reference:

    &opamp {
            ...
            refsel = AREF;
            extrefsel = AIN1;
            ...
    };

  The following example displays enabling the comparator
  in differential mode:

    &opamp {
            status = okay;
            main-mode = DIFF;
            psel = AIN0;
            extrefsel = AIN1;
            slew-rate = NORMAL;
    };

compatible: st,stm32-opamp

include:
  - opamp-controller.yaml

properties:
  main-mode:
    type: string
    enum:
      - SE
      - DIFF

  psel:
    type: string
    enum:
      - AIN0
      - AIN1
      - AIN2
      - AIN3
      - AIN4
      - AIN5
      - AIN6
      - AIN7
      - VDD_DIV2
      - VDDH_DIV5

  extrefsel:
    type: string
    enum:
      - AIN0
      - AIN1
      - AIN2
      - AIN3
      - AIN4
      - AIN5
      - AIN6
      - AIN7

  refsel:
    type: string
    enum:
      - INT_1V2
      - INT_1V8
      - INT_2V4
      - AVDDAO1V8
      - VDD
      - AREF

  slew-rate:
    type: string
    enum:
      - LOW
      - NORMAL
      - HIGH

  st,lock-enable:
    type: boolean
    description: |
      Lock the OPAMP configuration. This property is optional.
      If not set, the OPAMP configuration will be unlocked by default.
      The lock property is used to prevent accidental changes to the OPAMP
      configuration after it has been set.
```

## dts/bindings/opamp/zephyr,opamp-fake.yaml
```yaml
# Copyright (c) 2025 Alexander Kozhinov <ak.alexander.kozhinov@gmail.com>
# SPDX-License-Identifier: Apache-2.0

description: Fake opamp device used as stub or mock for testing

compatible: "zephyr,fake-opamp"

include: base.yaml
```

## subsys/net/lib/websocket_server/Kconfig
```kconfig
# Copyright (c) 2022 Alexander Kozhinov <ak.alexander.kozhinov@gmail.com>
# SPDX-License-Identifier: Apache-2.0

menuconfig WEBSOCKET_SERVER
	bool "Websocket server support [EXPERIMENTAL]"
	select NET_SOCKETS
	select MBEDTLS
	select BASE64
	select EXPERIMENTAL
	help
	  Enable Websocket server library.

config WEBSOCKET_SRV_PORT
	int "Weboscket server listen port"
	default 80 if !NET_SOCKETS_SOCKOPT_TLS
	default 443 if NET_SOCKETS_SOCKOPT_TLS
	help
	  Weboscket server listen port selector.

config WEBSOCKET_SRV_LISTEN_QUEUE_LEN
	int "The TCP port listen qeue length for incomming connection requests"
	default 3
	help
	  The TCP port listen qeue length for incomminc connection requests.

config WEBSOCKET_SRV_RCV_BUFF_SIZE
	int "The websocket server reciving buffer size in bytes"
	default 1280
	help
	  The websocket server reciving buffer size in bytes

config WEBSOCKET_SRV_SND_BUFF_SIZE
	int "The websocket server sending buffer size in bytes"
	default 1280
	help
	  The websocket server sending buffer size in bytes

config WEBSOCKET_SRV_MAX_CLIENTS
	int "The maximal number of clients can be accepted by the server"
	default 3
	help
	  The maximal number of clients can be accepted by the server

config WEBSOCKET_SRV_STACK_SIZE
	int "Defines clients processing threads stack size in bytes"
	default 2048
	help
	  The stack needed for tcp / clients processing threads

module = WEBSOCKET_SRV
module-dep = LOG
module-str = Log level for Websocket
module-help = Sets log level of Websocket server library.
source "subsys/net/Kconfig.template.log_config.net"
```

## tests/drivers/build_all/opamp/testcase.yaml
```yaml
common:
  build_only: true
  tags:
    - drivers
    - opamp

tests:
  drivers.build_all.opamp.stm32_opamp.opamp1:
    extra_args:
      - DTC_OVERLAY_FILE="stm32_opamp/opamp1.dts"
    filter: dt_has_compat("st,stm32-opamp")
```

## tests/drivers/opamp/gpio_loopback/testcase.yaml
```yaml
# Copyright (c) 2025 Alexander Kozhinov <ak.alexander.kozhinov@gmail.com>
# SPDX-License-Identifier: Apache-2.0

common:
  harness_config:
    fixture: gpio_loopback
  tags:
    - drivers
    - opamp
  harness: ztest

tests:
  drivers.opamp.gpio_loopback.stm32_opamp:
    filter: dt_compat_enabled("st,stm32-opamp")
```

## tests/drivers/opamp/shell/testcase.yaml
```yaml
# Copyright (c) 2025 Alexander Kozhinov <ak.alexander.kozhinov@gmail.com>
# SPDX-License-Identifier: Apache-2.0

tests:
  drivers.opamp.shell:
    platform_allow:
      - native_sim
      - native_sim/native/64
    tags:
      - drivers
      - opamp
      - shell
```

## tests/net/lib/websocket_server/testcase.yaml
```yaml
common:
  tags: websocket server testing
  # depends_on: websocket_server
tests:
  net.websocket_server:
    min_ram: 128
    # build_only: false
    platform_allow: native_posix
    # qemu_x86_64 nucleo_h745zi_q_m7 nucleo_h745zi_q_m4
```
